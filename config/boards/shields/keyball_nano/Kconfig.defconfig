## config/boards/shields/keyball_nano/Kconfig.defconfig
```kconfig
if SHIELD_KEYBALL_NANO_RIGHT

config ZMK_KEYBOARD_NAME
	default "Keyball_nano"

config ZMK_SPLIT_BLE_ROLE_CENTRAL
	default y

endif

if SHIELD_KEYBALL_NANO_LEFT || SHIELD_KEYBALL_NANO_RIGHT

config ZMK_SPLIT
	default y
	
endif
```

## config/boards/shields/keyball_nano/Kconfig.shield
```kconfig
config SHIELD_KEYBALL_NANO_LEFT
    def_bool $(shields_list_contains,keyball_nano_left)

config SHIELD_KEYBALL_NANO_RIGHT
    def_bool $(shields_list_contains,keyball_nano_right)
```
